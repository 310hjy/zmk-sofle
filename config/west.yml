## config/west.yml
```yaml
manifest:
  remotes:
    - name: zmkfirmware
      url-base: https://github.com/zmkfirmware
    - name: cormoran
      url-base: https://github.com/cormoran
    # 👇 [추가됨] 봉고 캣 모듈을 가져오기 위한 저장소 주소
    - name: mctechnology17
      url-base: https://github.com/mctechnology17
  projects:
    - name: eyelash_sofle
      url: https://github.com/a741725193/zmk-sofle
      revision: main
    - name: zmk
      remote: cormoran
      revision: v0.3-branch+dya
      import: app/west.yml
    - name: zmk-behavior-runtime-sensor-rotate
      remote: cormoran
      revision: main
    - name: zmk-module-ble-management
      remote: cormoran
      revision: zmk-v0.3.0.0
    - name: zmk-module-battery-history
      remote: cormoran
      revision: main
    - name: zmk-module-settings-rpc
      remote: cormoran
      revision: main
    - name: zmk-module-runtime-input-processor
      remote: cormoran
      revision: zmk-v0.3.0.0
    # 👇 [추가됨] 기존 코어를 건드리지 않고 봉고 캣 기능만 얹어주는 플러그인
    - name: zmk-nice-oled
      remote: mctechnology17
      revision: main
  self:
    path: config
```
